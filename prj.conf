## CMakeLists.txt
```
cmake_minimum_required(VERSION 3.20.0)
find_package(Zephyr REQUIRED HINTS $ENV{ZEPHYR_BASE})

project(NRF52_BLE_KeyBoard)

FILE(GLOB app_sources src/*.c)
target_sources(app PRIVATE ${app_sources})
```

## prj.conf
```kconfig
CONFIG_BT=y
CONFIG_BT_PERIPHERAL=y
CONFIG_BT_MAX_PAIRED=1
CONFIG_BT_DEVICE_NAME="Avinashee_Tech"

CONFIG_BT_KEYS_OVERWRITE_OLDEST=y
CONFIG_BT_SMP=y
CONFIG_BT_SETTINGS=y
CONFIG_BT_BONDABLE=y
CONFIG_BT_SETTINGS_CCC_STORE_ON_WRITE=y
CONFIG_BT_SETTINGS_CCC_LAZY_LOADING=n

CONFIG_BT_LIM_ADV_TIMEOUT=180

CONFIG_BT_BAS=y
CONFIG_BT_DIS=y
CONFIG_BT_DIS_PNP=n
CONFIG_BT_DIS_MODEL="Courage v1.0"
CONFIG_BT_DIS_MANUF="Avinashee Tech"
CONFIG_BT_DIS_SERIAL_NUMBER=y
CONFIG_BT_DIS_SERIAL_NUMBER_STR="0xAABBCCDD"

CONFIG_BT_DEVICE_APPEARANCE=961 
CONFIG_BT_PERIPHERAL_PREF_MIN_INT=6    
CONFIG_BT_PERIPHERAL_PREF_MAX_INT=18    
CONFIG_BT_PERIPHERAL_PREF_LATENCY=10   
CONFIG_BT_PERIPHERAL_PREF_TIMEOUT=200
CONFIG_BT_GAP_AUTO_UPDATE_CONN_PARAMS=y
```

## src/main.c
```c
//header files
#include <zephyr/kernel.h>
#include <zephyr/drivers/uart.h>  //for uart
#include <zephyr/device.h>
#include <zephyr/drivers/gpio.h>  //for button
#include <zephyr/sys/util.h>
#include <inttypes.h>

#include <zephyr/settings/settings.h>

#include "hid.h"

#define DEBUG 0     //enable uart based debug messages

/*
 * Button Macros and devicetree container
*/
#define BUTTON1_NODE  DT_NODELABEL(input_signal1)
#define BUTTON2_NODE  DT_NODELABEL(input_signal2)
#define BUTTON3_NODE  DT_NODELABEL(input_signal3)
#define BUTTON4_NODE  DT_NODELABEL(input_signal4)

#define BUTTON1_PIN  13   //0.13
#define BUTTON2_PIN  9    //0.09
#define BUTTON3_PIN  15   //0.15
#define BUTTON4_PIN  10   //0.10

static const struct gpio_dt_spec button1 = GPIO_DT_SPEC_GET_OR(BUTTON1_NODE, gpios,
							      {0});
static const struct gpio_dt_spec button2 = GPIO_DT_SPEC_GET_OR(BUTTON2_NODE, gpios,
                                  {0});
static const struct gpio_dt_spec button3 = GPIO_DT_SPEC_GET_OR(BUTTON3_NODE, gpios,
                                  {0});
static const struct gpio_dt_spec button4 = GPIO_DT_SPEC_GET_OR(BUTTON4_NODE, gpios,
                                  {0});

/*
 * Uart configuration
*/

const struct device *uart_dev = DEVICE_DT_GET(DT_NODELABEL(uart0));
const struct uart_config uart_cfg = {
		.baudrate = 115200,
		.parity = UART_CFG_PARITY_NONE,
		.stop_bits = UART_CFG_STOP_BITS_1,
		.data_bits = UART_CFG_DATA_BITS_8,
		.flow_ctrl = UART_CFG_FLOW_CTRL_NONE
};


/*
 * Bluetooth Macros and variables
*/

/* Key used for left arrow */
#define KEY_LEFT_ARROW_MASK   	   BIT(BUTTON1_PIN)
/* Key used for right arrow */
#define KEY_RIGHT_ARROW_MASK  	   BIT(BUTTON2_PIN)
/* Key used for up arrow */
#define KEY_UP_ARROW_MASK	       BIT(BUTTON3_PIN)
/* Key used for down arrow */
#define KEY_DOWN_ARROW_MASK	       BIT(BUTTON4_PIN)


//HID Codes
#define RIGHT_ARROW 0x4F
#define LEFT_ARROW  0x50
#define DOWN_ARROW  0x51
#define UP_ARROW    0x52

#define KEYS_MONITORING_PERIOD_MS	50   //monitor key after given interval

#define DEVICE_NAME             CONFIG_BT_DEVICE_NAME     //ble device name
#define DEVICE_NAME_LEN         (sizeof(DEVICE_NAME) - 1) 

#define BT_ADV_INT_MIN  48 /* 0.625ms units --> 30ms */
#define BT_ADV_INT_MAX  80 /* 0.625ms units --> 50ms */


char ble_uart_buffer[150] = {0};    //buffer to transmit bluetooth specific messages over uart
volatile uint8_t notify_client = 0; //flag for notification enable/disable status
struct bt_conn *my_connection;      //bluetooth connection reference struct

static bt_addr_le_t bonded_addr;    //record bonded device address
static bool bonded_addr_present;    //check if bonded device present

static bool dir_adv_timeout;
static bool is_connected;
static int64_t last_advertising_start_ms;

static struct k_work adv_work;      //advertising work structure
static K_SEM_DEFINE(ble_init_ok, 0, 1); //semaphore for ble initialization

/*
 * ble device advertisement (GAP)
*/

static const struct bt_data ad[] = //advertising data setup
{
    BT_DATA_BYTES(BT_DATA_GAP_APPEARANCE,
        (CONFIG_BT_DEVICE_APPEARANCE >> 0) & 0xff,
        (CONFIG_BT_DEVICE_APPEARANCE >> 8) & 0xff),

	BT_DATA_BYTES(BT_DATA_FLAGS, (BT_LE_AD_LIMITED | BT_LE_AD_NO_BREDR)), 

    BT_DATA_BYTES(BT_DATA_UUID16_ALL, BT_UUID_16_ENCODE(NRF52_SVC_HID_UUID), BT_UUID_16_ENCODE(NRF52_SVC_BAT_UUID),
                BT_UUID_16_ENCODE(NRF52_SVC_DEV_UUID),
),
	
};
static const struct bt_data sd[] = //scan response data setup
{
	BT_DATA(BT_DATA_NAME_COMPLETE, DEVICE_NAME, DEVICE_NAME_LEN),
};

/*
 *@brief : function to retrieve bonded address
 *@param : bonded device info pointer
 *@retval : None 
 *@note : gets the stored bonded device address
*/
static void bonded_addr_cache(const struct bt_bond_info *info, void *user_data)
{
    memcpy(&bonded_addr, &info->addr, sizeof(bt_addr_le_t));
    bonded_addr_present = true;
}

/*
 *@brief : advertising start function
 *@param : None
 *@retval : None 
 *@note : only one paired device is supported, so the function passed as argument is invoked once at most
*/
static void advertising_start(void)
{
    bt_foreach_bond(BT_ID_DEFAULT, bonded_addr_cache, NULL); //go through existing bonds
    k_work_submit(&adv_work);  //submit work for execution to system workqueue thread
}

/*
 *@brief : uart tranmsit function
 *@param : buffer to be transmitted
 *@retval : None 
 *@note : function to transmit uart messages using blocking poll out method
*/
void nrf52_uart_tx(uint8_t *tx_buff){
	for(int buflen=0;buflen<=strlen(tx_buff);buflen++){
                uart_poll_out(uart_dev,*(tx_buff+buflen));
	}
	k_msleep(100);
}


/*
 *@brief : bluetooth notification function 
 *@param : modifiers byte(caps lock, numlock etc. keys), key pressed array(max 6 presses at a time)
 *@retval : None 
 *@note : This function sends a notification to a Client with the provided data according to the protocol
          mode selected (boot or report) if notification is enabled
*/
void send_notification(uint8_t modifiers, uint8_t* key_press)
{
    uint8_t current_prot_mode = hids_prot_mode();

    if(hids_report_writable()){               //check if respective mode notification is enabled
        if(current_prot_mode==0x00){          //Boot Mode
            hids_report_kb_t boot_report_t = {   
                .modifiers = modifiers,
                .reserved = 0,
                .key_pressed = {key_press[0],key_press[1],key_press[2],key_press[3],key_press[4],key_press[5]},
            };

            hids_kb_notify_input_boot(&boot_report_t,sizeof(hids_report_kb_t));  //sends notification


        }else if(current_prot_mode==0x01){    //Report Mode
            hids_report_kb_t report_t = {              
                .modifiers = modifiers,
                .reserved = 0,
                .key_pressed = {key_press[0],key_press[1],key_press[2],key_press[3],key_press[4],key_press[5]},
            };

            hids_kb_notify_input(&report_t,sizeof(hids_report_kb_t));                               //sends notification
            
        }
             
        }
    
}




/*
 *@brief : function to act according to button pressed
 *@param : all buttons state at the moment, buttons whose state has changed
 *@retval : None 
 *@note : take action according to the keys that are pressed (left, right, up or down arrows in our case)
*/
static void take_action(uint32_t button_state, uint32_t has_changed)
{
    uint8_t key_pressed[6] = {0};

    if((has_changed & KEY_LEFT_ARROW_MASK) & (button_state & KEY_LEFT_ARROW_MASK)){
        key_pressed[0] = LEFT_ARROW;
        send_notification(0, key_pressed);
#if DEBUG
            nrf52_uart_tx("left arrow\n");
#endif
    } 
    else if((has_changed & KEY_RIGHT_ARROW_MASK) & (button_state & KEY_RIGHT_ARROW_MASK))
    {
        key_pressed[0] = RIGHT_ARROW;
        send_notification(0, key_pressed);
#if DEBUG
            nrf52_uart_tx("right arrow\n");
#endif
    }
    else if((has_changed & KEY_UP_ARROW_MASK) & (button_state & KEY_UP_ARROW_MASK))
    {
        key_pressed[0] = UP_ARROW;
        send_notification(0, key_pressed);
#if DEBUG
            nrf52_uart_tx("up arrow\n");
#endif
    }
    else if((has_changed & KEY_DOWN_ARROW_MASK) & (button_state & KEY_DOWN_ARROW_MASK))
    {
        key_pressed[0] = DOWN_ARROW;
        send_notification(0, key_pressed);
#if DEBUG
            nrf52_uart_tx("down arrow\n");
#endif
    }
    else{
        memset(key_pressed,0,sizeof(key_pressed));
        send_notification(0, key_pressed);
    }
}


/*
 *@brief : function to execute advertising
 *@param : None
 *@retval : None 
 *@note : Directed or regular advertising options available
*/
static void advertising_exec(void)
{
    int err = 0;
    struct bt_le_adv_param adv_param;

    /* Directed advertising if bonding is present and we did not already timed out */
    if ((bonded_addr_present) && (!dir_adv_timeout))
    {
        char addr_buf[BT_ADDR_LE_STR_LEN];

        adv_param = *BT_LE_ADV_CONN_DIR(&bonded_addr);
        adv_param.options |= BT_LE_ADV_OPT_DIR_ADDR_RPA;

        err = bt_le_adv_start(&adv_param, NULL, 0, NULL, 0);      //start adv.
        if (err)
        {

#if DEBUG
            memset(ble_uart_buffer,0,sizeof(ble_uart_buffer));
            sprintf(ble_uart_buffer,"Directed advertising failed to start (err %d)\n", err);
            nrf52_uart_tx(ble_uart_buffer);
#endif

            return;
        }

        bt_addr_le_to_str(&bonded_addr, addr_buf, BT_ADDR_LE_STR_LEN);  //bonded addr to string

#if DEBUG
        memset(ble_uart_buffer,0,sizeof(ble_uart_buffer));
        sprintf(ble_uart_buffer,"Direct advertising to %s started\n", addr_buf);
        nrf52_uart_tx(ble_uart_buffer);
#endif

    }
    /* Regular advertising if no bonding is present */
    else
    {
        adv_param = *BT_LE_ADV_CONN;
        adv_param.interval_min = BT_ADV_INT_MIN;
        adv_param.interval_max = BT_ADV_INT_MAX;
        adv_param.options |= BT_LE_ADV_OPT_ONE_TIME | BT_LE_ADV_OPT_SCANNABLE;

        err = bt_le_adv_start(&adv_param, ad, ARRAY_SIZE(ad), sd, ARRAY_SIZE(sd));  //start adv.
        if (err)
        {

#if DEBUG
            memset(ble_uart_buffer,0,sizeof(ble_uart_buffer));
            sprintf(ble_uart_buffer,"Advertising failed to start (err %d)\n", err);
            nrf52_uart_tx(ble_uart_buffer);
#endif

            return;
        }

#if DEBUG
        nrf52_uart_tx("Regular advertising started\n");
#endif

    }

    if(err == 0)
    {
        /* Cache last start of advertising */
        last_advertising_start_ms = k_uptime_get();
    }
}

/*
 *@brief : work item handler function
 *@param : pointer to work structure 
 *@retval : None 
*/
static void advertising_process(struct k_work *work)
{
    advertising_exec();
}

/*
 *@brief : bluetooth connection callback function
 *@param : bluetooth connection structure , error status
 *@retval : None 
 *@note : This function is called whenever the device is connected with a Client
*/
static void connected(struct bt_conn *conn, uint8_t err)
{
	struct bt_conn_info info; 
	char addr[BT_ADDR_LE_STR_LEN];

	my_connection = conn;

    if (err) 
    {
        if (err == BT_HCI_ERR_ADV_TIMEOUT)  //adv timed out error
        {

#if DEBUG
            nrf52_uart_tx("Direct advertising timed out\n");
#endif

            dir_adv_timeout = true;
            k_work_submit(&adv_work);       //resubmit adv work
        }
        else
        {

#if DEBUG            
            memset(ble_uart_buffer,0,sizeof(ble_uart_buffer));
            sprintf(ble_uart_buffer,"Failed to connect (%u)\n", err);
            nrf52_uart_tx(ble_uart_buffer);
#endif

        }

        return;
    }

    //check for connection info on successful connection
	if(bt_conn_get_info(conn, &info)!=0)
	{

#if DEBUG
		nrf52_uart_tx("connection info unavailable\n");
#endif

		return;
	}
	else
	{
		
		bt_addr_le_to_str(bt_conn_get_dst(conn), addr, sizeof(addr));  //get peer address in string format

#if DEBUG
		memset(ble_uart_buffer,0,sizeof(ble_uart_buffer));
		sprintf(ble_uart_buffer,"Connected to: %s					\n \
			Role: %u							\n \
			Conn ivl: %u				\n \
			Slv lat: %u					\n \
			Conn timeout: %u	\n" 
			, addr, info.role, info.le.interval, info.le.latency, info.le.timeout
		);
		nrf52_uart_tx(ble_uart_buffer);
#endif

    }

    //update variables
    is_connected = true;
    dir_adv_timeout = false;
    last_advertising_start_ms = 0;

    /* Inform HID Service */
    hids_connected(conn);

}


/*
 *@brief : bluetooth disconnection callback function
 *@param : bluetooth connection structure , reason for disconnection
 *@retval : None 
 *@note :  This function is called whenever the device is disconnected from a Client
*/
static void disconnected(struct bt_conn *conn, uint8_t reason)
{

#if DEBUG
	memset(ble_uart_buffer,0,sizeof(ble_uart_buffer));
	sprintf(ble_uart_buffer,"Dis.(%u)\n", reason);
	nrf52_uart_tx(ble_uart_buffer);
#endif

    is_connected = false;  //update variable

    /* Inform HID Service */
    hids_disconnected();

    /* Re-start advertising */
    advertising_start();
}

/*
 *@brief : security changed callback function
 *@param : bluetooth connection structure, security level selected, error if any 
 *@retval : None 
 *@note :  This function is called whenever Client requests an update in security level
*/
static void security_changed(struct bt_conn *conn, bt_security_t level,
    enum bt_security_err err)
{
    char addr[BT_ADDR_LE_STR_LEN];
    memset(ble_uart_buffer,0,sizeof(ble_uart_buffer));

    bt_addr_le_to_str(bt_conn_get_dst(conn), addr, sizeof(addr));    

    if (!err)
    {
        sprintf(ble_uart_buffer,"Security changed: %s lvl %u\n", addr, level);
    }
    else
    {
        sprintf(ble_uart_buffer,"Security failed: %s lvl %u err %d\n", addr, level, err);
    }
#if DEBUG
    nrf52_uart_tx(ble_uart_buffer);
#endif

}

/*
 *@brief : connection params updated callback function
 *@param : bluetooth connection structure, connection interval, latency and timeout
 *@retval : None 
 *@note :  This function is called whenever Client requests an update in parameters 
           related to connection
*/
static void conn_params_updated(struct bt_conn *conn, uint16_t interval,
    uint16_t latency, uint16_t timeout)
{
    struct bt_conn_info info;
    bt_conn_get_info(conn, &info);

#if DEBUG
    memset(ble_uart_buffer,0,sizeof(ble_uart_buffer));
    sprintf(ble_uart_buffer,"Conn params updated, ivl: %u, lat: %u, timeout: %u\n",
    info.le.interval, info.le.latency, info.le.timeout);
    nrf52_uart_tx(ble_uart_buffer);
#endif

}

/*
  * structure for connection based callbacks
*/
static struct bt_conn_cb conn_callbacks = 
{
	.connected			= connected,
	.disconnected   	= disconnected,
    .security_changed   = security_changed,
    .le_param_updated   = conn_params_updated,
};


/*
 *@brief : pairing complete callback function
 *@param : bluetooth connection structure, bonding status
 *@retval : None 
 *@note :  This function is called when pairing process is completed between device and client
*/
static void pairing_complete(struct bt_conn *conn, bool bonded)
{
    char addr[BT_ADDR_LE_STR_LEN];
    bt_addr_le_to_str(bt_conn_get_dst(conn), addr, sizeof(addr));

#if DEBUG
    memset(ble_uart_buffer,0,sizeof(ble_uart_buffer));
    sprintf(ble_uart_buffer,"Pairing completed: %s, bonded: %d\n", addr, bonded);
    nrf52_uart_tx(ble_uart_buffer);
#endif

}

/*
 *@brief : pairing failure callback function
 *@param : bluetooth connection structure, reason for failure
 *@retval : None 
 *@note :  This function is called when pairing process fails
*/
static void pairing_failed(struct bt_conn *conn, enum bt_security_err reason)
{
    char addr[BT_ADDR_LE_STR_LEN];
    bt_addr_le_to_str(bt_conn_get_dst(conn), addr, sizeof(addr));

#if DEBUG
    memset(ble_uart_buffer,0,sizeof(ble_uart_buffer));
    sprintf(ble_uart_buffer,"Pairing failed conn: %s, reason %d\n", addr, reason);
    nrf52_uart_tx(ble_uart_buffer);
#endif

}

/*
  * structure for connection authentication based callbacks
*/
static struct bt_conn_auth_info_cb conn_auth_info_callbacks = {
    .pairing_complete = pairing_complete,
    .pairing_failed   = pairing_failed,
};

/*
 *@brief : Callback for notifying that Bluetooth has been enabled.
 *@param : error condition (zero on success or (negative) error code otherwise.)
 *@retval : None 
*/
static void bt_ready(int err)
{
	if (err) 
	{
#if DEBUG
		memset(ble_uart_buffer,0,sizeof(ble_uart_buffer));
		sprintf(ble_uart_buffer,"BLE init failed with error code %d\n", err);
		nrf52_uart_tx(ble_uart_buffer);
#endif
        return;
	}

	//Register connection callback
	bt_conn_cb_register(&conn_callbacks);

    //Register authentication information callback
    bt_conn_auth_info_cb_register(&conn_auth_info_callbacks);

	k_sem_give(&ble_init_ok); //give semaphore
}


/*
 *@brief : function to read button status
 *@param : pointer to current button state variable, pointer to buttons that have changed variable 
 *@retval : None 
 *@note :  This function is called after specified delay of 50ms to read status of buttons.
           Button 1 - used for left click, moving left, moving up and scrolling up 
           Button 2 - used for right click, moving right, moving down and scrolling down
           Button 3 - used to select previous input mode 
           Button 4 - used to select next input mode
*/
void read_buttons(uint32_t* buttons_state, uint32_t* buttons_changed){

    static int previous_button_val[4] = {0};
    int current_button_val[4] = {0};
    uint32_t current_buttons_state = 0;
    uint32_t current_buttons_changed = 0;
    
    //button 1
    current_button_val[0] = gpio_pin_get_dt(&button1); //get button1 status
#if DEBUG
    if(current_button_val[0]==1){
        nrf52_uart_tx("button 1 pressed");
    }
#endif
    __ASSERT_NO_MSG(current_button_val[0]>=0);
    if(previous_button_val[0]!=current_button_val[0]){        //check for any change in button 1
        previous_button_val[0] = current_button_val[0];
        current_buttons_changed |= BIT(BUTTON1_PIN);
        current_buttons_state |= (current_button_val[0]<<BUTTON1_PIN);
    }

    //button 2
    current_button_val[1] = gpio_pin_get_dt(&button2); //get button2 status
#if DEBUG
    if(current_button_val[1]==1){
        nrf52_uart_tx("button 2 pressed");
    }
#endif
    __ASSERT_NO_MSG(current_button_val[1]>=0);                //check for any change in button 2
    if(previous_button_val[1]!=current_button_val[1]){
        previous_button_val[1] = current_button_val[1];
        current_buttons_changed |= BIT(BUTTON2_PIN);
        current_buttons_state |= (current_button_val[1]<<BUTTON2_PIN);
    }

    //button 3
    current_button_val[2] = gpio_pin_get_dt(&button3); //get button3 status
#if DEBUG
    if(current_button_val[2]==1){
        nrf52_uart_tx("button 3 pressed");
    }
#endif
    __ASSERT_NO_MSG(current_button_val[2]>=0);
    if(previous_button_val[2]!=current_button_val[2]){        //check for any change in button 3
        previous_button_val[2] = current_button_val[2];
        current_buttons_changed |= BIT(BUTTON3_PIN);
        current_buttons_state |= (current_button_val[2]<<BUTTON3_PIN);
    }

    //button 4
    current_button_val[3] = gpio_pin_get_dt(&button4); //get button4 status
#if DEBUG
    if(current_button_val[3]==1){
        nrf52_uart_tx("button 4 pressed");
    }
#endif
    __ASSERT_NO_MSG(current_button_val[3]>=0);
    if(previous_button_val[3]!=current_button_val[3]){       //check for any change in button 4
        previous_button_val[3] = current_button_val[3];
        current_buttons_changed |= BIT(BUTTON4_PIN);
        current_buttons_state |= (current_button_val[3]<<BUTTON4_PIN);
    }



    *buttons_state = current_buttons_state;                 //update button status
    *buttons_changed = current_buttons_changed;             //update buttons that have changed
}

/*
 *@brief : main function
 *@param : execution status
 *@retval : None 
*/
int main(void)
{	    
        /******************************************************************** 
        ***************************Button Section****************************
        ********************************************************************/
	
        int err;

        //Button 1 - used for left arrow
        if (!gpio_is_ready_dt(&button1)) { //check if gpio ready 
                return 0;
        }

        err = gpio_pin_configure_dt(&button1, GPIO_INPUT); //input gpio direction
        if (err != 0) {
                return 0;
        }
	    
        //Button 2 - used for right arrow
        if (!gpio_is_ready_dt(&button2)) { //check if gpio ready 
            return 0;
        }

        err = gpio_pin_configure_dt(&button2, GPIO_INPUT); //input gpio direction
        if (err != 0) {
            return 0;
        }

        //Button 3 - used for up arrow 
        if (!gpio_is_ready_dt(&button3)) { //check if gpio ready 
            return 0;
        }

        err = gpio_pin_configure_dt(&button3, GPIO_INPUT); //input gpio direction
        if (err != 0) {
            return 0;
        }
    
        //Button 4 - used for down arrow
        if (!gpio_is_ready_dt(&button4)) { //check if gpio ready 
            return 0;
        }

        err = gpio_pin_configure_dt(&button4, GPIO_INPUT); //input gpio direction
        if (err != 0) {
           return 0;
        } 


        /********************************************************************* 
        *************************Bluetooth Section****************************
        *********************************************************************/
        
        //Enable Bluetooth
        err = bt_enable(bt_ready);
        if (err) 
        {
		//Bluetooth Enabling failed
#if DEBUG
		  nrf52_uart_tx("bluetooth enable error\n"); 
#endif
	    }

         	
        //Bluetooth stack should be ready in less than 100 msec. 								
        //We use this semaphore to wait for bt_enable to call bt_ready.
        //This task/thread is blocked for the time period or until semaphore is given back.... 	

        err = k_sem_take(&ble_init_ok, K_MSEC(500));
        if (!err) 
        {
		  //Bluetooth initialized
	    } else 
	    {
        //Bluetooth initialization did not complete in Time
#if DEBUG
		  nrf52_uart_tx("bluetooth init timeout\n");
#endif
	    }

        //needed for bonding configuration settings
        if (IS_ENABLED(CONFIG_SETTINGS))   
        {
            settings_load();
        }

    
        /* Init workqueue item to help during advertising */
        k_work_init(&adv_work, advertising_process);

        /* Immediately request advertising to start by submitting work*/
        advertising_start();

        /********************************************************************* 
        ****************************Uart Section******************************
        *********************************************************************/
        
        if (!device_is_ready(uart_dev)) {  //check if device ready
                return 0;
        }

        err = uart_configure(uart_dev, &uart_cfg);  //set cfg.
        if (err == -ENOSYS) {
                return -ENOSYS;
        }

        //variables for button input
        uint32_t buttons_state = 0;
        uint32_t buttons_changed = 0;
        uint32_t buttons_just_set = 0;

        while(1){

            /* If we are not connected, check the advertising timeout as termination condition */
            if(!is_connected)
            {
                int64_t ref_time = last_advertising_start_ms;

                if ((ref_time != 0) && k_uptime_delta(&ref_time) >= (CONFIG_BT_LIM_ADV_TIMEOUT * 1000))
                {
#if DEBUG
                  nrf52_uart_tx("reset board to restart the application...\n");
#endif
                  break;
                }
            }

            /* Get current buttons state and witness buttons just set*/
            read_buttons(&buttons_state, &buttons_changed);
            buttons_just_set = buttons_state & buttons_changed;

            /* take keyboard related action, depending on key pressed */
            take_action(buttons_state, buttons_changed);
        
            /* Sleep */
            k_sleep(K_MSEC(KEYS_MONITORING_PERIOD_MS));
        }
}
```

## src/hid.c
```c
#include "hid.h"


extern struct bt_conn *my_connection; //bluetooth connection reference struct

/********************
 * HID Information  *
*********************/ 

// HID Info flags 
enum
{
    REMOTE_WAKE            = BIT(0),
    NORMALLY_CONNECTABLE   = BIT(1),
};

/* 
 * HID Info structure
 * NOTE: pack your structures to avoid byte padding and save power and 
 * transmission time over BLE
 */
typedef struct{
    uint16_t hid_version;
    uint8_t country_code;
    uint8_t flags;
}__attribute__((__packed__)) _hids_info_t_;

const _hids_info_t_ hids_info = {
    .hid_version = 0x0101,
    .country_code = 0x00,
    .flags = NORMALLY_CONNECTABLE,
};

// HID Info callback
ssize_t readinfo_cb(struct bt_conn *conn,const struct bt_gatt_attr *attr,void *buf, uint16_t len,uint16_t offset){
    return bt_gatt_attr_read(conn,attr,buf,len,offset,&hids_info,sizeof(_hids_info_t_));
}

/********************
 * HID Report Map  *
*********************/ 

// HID Report map
const uint8_t report_map[] =
{
    /* KeyBoard INPUT REPORT MAP */
    0x05, 0x01,                 // Usage Page (Generic Desktop Ctrls)
    0x09, 0x06,                 // Usage (KeyBoard)
    0xA1, 0x01,                 // Collection (Application)
    0x85, 0x01,                 //   Report ID (1)
    0x05, 0x07,                 //   Usage Page (KeyCodes)
    0x19, 0xE0,                 //   Usage Minimum (224),
    0x29, 0xE7,                 //   Usage Maximum (231),
    0x15, 0x00,                 //   Logical Minimum (0),
    0x25, 0x01,                 //   Logical Maximum (1), 
    0x75, 0x01,                 //   Report Size (1),
    0x95, 0x08,                 //   Report Count (8), 
    0x81, 0x02,                 //   Input (Data, Variable, Absolute),   Modifier Byte 
    0x95, 0x01,                 //   Report Count (1)
    0x75, 0x08,                 //   Report Size (8)
    0x81, 0x01,                 //   Input (Constant),   Reserved Byte
    0x95, 0x05,                 //   Report Count (5), 
    0x75, 0x01,                 //   Report Size (1), 
    0x05, 0x08,                 //   Usage Page (Page# for LEDs), 
    0x19, 0x01,                 //   Usage Minimum (1), 
    0x29, 0x05,                 //   Usage Maximum (5),
    0x91, 0x02,                 //   Output (Data, Variable, Absolute),   Led report
    0x95, 0x01,                 //   Report Count (1), 
    0x75, 0x03,                 //   Report Size (3),
    0x91, 0x01,                 //   Output (Constant),    Led report padding
    0x95, 0x06,                 //   Report Count (6), 
    0x75, 0x08,                 //   Report Size (8), 
    0x15, 0x00,                 //   Logical Minimum (0), 
    0x25, 0xFF,                 //   Logical Maximum (255)
    0x05, 0x07,                 //   Usage Page (Key Codes), 
    0x19, 0x00,                 //   Usage Minimum (0), 
    0x29, 0xFF,                 //   Usage Maximum (255), 
    0x81, 0x00,                 //   Input (Data, Array),   Key arrays (6 bytes)
    0xC0,                       // End Collection
};

//HID Report Map callback
ssize_t readreportmap_cb(struct bt_conn *conn,const struct bt_gatt_attr *attr,void *buf, uint16_t len,uint16_t offset){
    return bt_gatt_attr_read(conn,attr,buf,len,offset,report_map,sizeof(report_map));
}

/*********************
 * HID Control Point *
**********************/ 

//HID Control Point Device States
enum{
    SUSPEND = 0x00,
    EXIT_SUSPEND = 0x01,
};

typedef uint8_t hid_ctrl_point;

//HID Control Point callback
ssize_t writectrl_cb(struct bt_conn *conn,const struct bt_gatt_attr *attr,const void *buf, uint16_t len,uint16_t offset, uint8_t flags){
    
    uint8_t ctrl_point_value = *((uint8_t*)buf);
    hid_ctrl_point ctrl_point;
    uint8_t* ctrl_point_buf = (uint8_t*)&ctrl_point;

    //check flags
    if(flags!=BT_GATT_WRITE_FLAG_CMD){
        /* Only write without response accepted */
        return BT_GATT_ERR(BT_ATT_ERR_WRITE_REQ_REJECTED);
    }

    //check length
    if((offset+len)>sizeof(hid_ctrl_point)){
        /* Make sure client writes with correct offset */
        return BT_GATT_ERR(BT_ATT_ERR_INVALID_OFFSET);
    }

    //check value
    if((ctrl_point_value!=SUSPEND) | (ctrl_point_value!=EXIT_SUSPEND)){
        return BT_GATT_ERR(BT_ATT_ERR_NOT_SUPPORTED);
    }

    memcpy(ctrl_point_buf+offset, buf, len);

    return len;

}



/*********************
 * HID Input Report  *
**********************/ 

bool input_rep_notif_enabled;

#define REPORT_KB_SIZE sizeof(hids_report_kb_t)
uint8_t input_report[REPORT_KB_SIZE];

//HID Report Info structure
typedef struct
{
    uint8_t* const report_ref;
    uint8_t report_len;

} hids_report_info_t;

const hids_report_info_t input_rep_info =
{
    .report_ref = input_report,
    .report_len = sizeof(input_report),
};

// HID Report Characteristic Descriptor 
typedef struct
{
    uint8_t id;                 //report id 
    uint8_t type;               //report type
} __packed hids_report_desc_t;

// Report descriptor
const uint8_t HIDS_REPORT_ID_KB = 0x01;

// Report direction
enum{
    HIDS_REPORT_INPUT   = 0x01,
    HIDS_REPORT_OUTPUT  = 0x02,
    HIDS_REPORT_FEATURE = 0x03,
};

//descriptor
const hids_report_desc_t input_desc =
{
    .id = HIDS_REPORT_ID_KB,
    .type = HIDS_REPORT_INPUT,

};

/*
 * HID Regular Report read callback
*/
ssize_t readreport_cb(struct bt_conn *conn,const struct bt_gatt_attr *attr,void *buf, uint16_t len,uint16_t offset){
    const hids_report_info_t* hids_report = (const hids_report_info_t*)attr->user_data;
    return bt_gatt_attr_read(conn,attr,buf,len,offset,hids_report->report_ref,hids_report->report_len);
}

/*
 * CCCD callback function for regular report mode
*/
void input_rep_changed(const struct bt_gatt_attr *attr, uint16_t value){
    ARG_UNUSED(attr);
    switch(value)
    {
        case BT_GATT_CCC_NOTIFY: 
            // Start sending stuff! No ACK
            nrf52_uart_tx("reg. report en");
			input_rep_notif_enabled = 1;  //notify data send start
            break;

        case 0: 
            // Stop sending stuff
			input_rep_notif_enabled = 0;  //notify data send stop
            break;
        
        default: 
            //Error, CCCD set to an invalid value    
    } 
}

/*
 * regular report description read callback
*/
ssize_t read_reportdesc_cb(struct bt_conn *conn,const struct bt_gatt_attr *attr,void *buf, uint16_t len,uint16_t offset){
    return bt_gatt_attr_read(conn,attr,buf,len,offset,attr->user_data,sizeof(input_desc));
}


/*********************
 * HID Protocol Mode *
**********************/

uint8_t prot_mode;

//HID Protocol modes
enum{
    BOOT_MODE   = 0x00,
    REPORT_MODE = 0x01,
};

/* 
 * HID Protocol read callback
*/
ssize_t readprot_cb(struct bt_conn *conn,const struct bt_gatt_attr *attr,void *buf, uint16_t len,uint16_t offset){
    return bt_gatt_attr_read(conn, attr, buf, len, offset, &prot_mode, sizeof(prot_mode));
}

/*
 * HID Protocol write callback
*/
ssize_t writeprot_cb(struct bt_conn *conn,const struct bt_gatt_attr *attr,const void *buf, uint16_t len,uint16_t offset, uint8_t flags){

    uint8_t prot_mode_value = *(uint8_t*)buf;
    uint8_t* prot_mode_buf = (uint8_t*)&prot_mode;

    //check flags
    if(flags!=BT_GATT_WRITE_FLAG_CMD){
        /* Only write without response accepted */
        return BT_GATT_ERR(BT_ATT_ERR_WRITE_REQ_REJECTED);
    }

    //check len
    if((offset+len)>sizeof(prot_mode)){
        /* Make sure client writes with correct offset */
        return BT_GATT_ERR(BT_ATT_ERR_INVALID_OFFSET);
    }

    //check value
    if((prot_mode_value!=BOOT_MODE) | (prot_mode_value!=REPORT_MODE)){
        return BT_GATT_ERR(BT_ATT_ERR_NOT_SUPPORTED);
    }

    memcpy(prot_mode_buf+offset, buf, len);

    return len;

}

/*******************************
 * HID Boot KeyBoard Input Report *
********************************/

#define BOOT_REPORT_KB_SIZE sizeof(hids_report_kb_t)
uint8_t boot_input_report[BOOT_REPORT_KB_SIZE];

bool boot_input_rep_notif_enabled;

//hid boot report structure init 
const hids_report_info_t boot_input_rep_info =
{
    .report_ref = boot_input_report,
    .report_len = sizeof(boot_input_report)
};

/*
 * CCCD callback function for boot report mode
*/
void boot_input_rep_changed(const struct bt_gatt_attr *attr, uint16_t value){
    ARG_UNUSED(attr);
    switch(value)
    {
        case BT_GATT_CCC_NOTIFY: 
            // Start sending stuff! No ACK
			boot_input_rep_notif_enabled = 1;  //notify data send start
            break;

        case 0: 
            // Stop sending stuff
			boot_input_rep_notif_enabled = 0;  //notify data send stop
            break;
        
        default: 
            //Error, CCCD set to an invalid value    
    } 
}

/*
 * register ble service  (GATT)
*/
BT_GATT_SERVICE_DEFINE(my_service,
    BT_GATT_PRIMARY_SERVICE(BT_UUID_HIDS),      //Service Setup
    //Characteristic setup
    //HID Information
    BT_GATT_CHARACTERISTIC(NRF52_CHAR_HIDINFO_UUID, 
                            BT_GATT_CHRC_READ,
                            BT_GATT_PERM_READ,
                            readinfo_cb, NULL, NULL),
    //HID Report Map
    BT_GATT_CHARACTERISTIC(NRF52_CHAR_HIDMAP_UUID,
                            BT_GATT_CHRC_READ,
                            BT_GATT_PERM_READ,
                            readreportmap_cb, NULL, NULL),
    //HID Control Point
    BT_GATT_CHARACTERISTIC(NRF52_CHAR_HIDCTRL_UUID,
                            BT_GATT_CHRC_WRITE_WITHOUT_RESP,
                            BT_GATT_PERM_WRITE,
                            NULL, writectrl_cb, NULL),
    //HID Input Report for KeyBoard
    BT_GATT_CHARACTERISTIC(NRF52_CHAR_HIDREPORT_UUID,
                            BT_GATT_CHRC_READ | BT_GATT_CHRC_NOTIFY,
                            BT_GATT_PERM_READ,
                            readreport_cb, NULL,
                            (hids_report_info_t*)&input_rep_info),
    
    BT_GATT_CCC(input_rep_changed,  //Client Characteristic Configuration Descriptor - Enable/Disable of Notification
        BT_GATT_PERM_READ | BT_GATT_PERM_WRITE),
    
    BT_GATT_DESCRIPTOR(BT_UUID_HIDS_REPORT_REF,
                        BT_GATT_PERM_READ,
                        read_reportdesc_cb, NULL,
                        (hids_report_desc_t*) &input_desc),

    //HID Protocol Mode
    BT_GATT_CHARACTERISTIC(NRF52_CHAR_HIDPROT_UUID,
                            BT_GATT_CHRC_READ | BT_GATT_CHRC_WRITE_WITHOUT_RESP,
                            BT_GATT_PERM_READ | BT_GATT_PERM_WRITE,
                            readprot_cb, writeprot_cb, NULL),
    //HID Boot Mouse Input Report
    BT_GATT_CHARACTERISTIC(NRF52_CHAR_HIDBOOTREPORT_UUID,
                            BT_GATT_CHRC_READ | BT_GATT_CHRC_NOTIFY,
                            BT_GATT_PERM_READ,
                            readreport_cb, NULL,
                            (hids_report_info_t*)&boot_input_rep_info),
    
    BT_GATT_CCC(boot_input_rep_changed,  //Client Characteristic Configuration Descriptor - Enable/Disable of Notification
            BT_GATT_PERM_READ | BT_GATT_PERM_WRITE),
    
);

/*
 * updates connection reference once device connected
*/
void hids_connected(struct bt_conn *conn){
    my_connection = conn;
    prot_mode = REPORT_MODE; //Set Protocol Mode back to default (Report)
}

/*
 * updates connection reference once device disconnected
*/
void hids_disconnected(void){
    my_connection = NULL;
}

/*
 * returns current selected protocol mode by client (regular report or boot report)
*/
uint8_t hids_prot_mode(void){
    return prot_mode;
}

/*
 * checks if report is writable or not (CCCD flag enabled or not)
*/
bool hids_report_writable(void){
    if(prot_mode == BOOT_MODE)
    {
        return boot_input_rep_notif_enabled;
    }
    else
    {
        return input_rep_notif_enabled;
    }
}

/*
 *@brief : function to notify regular report data
 *@param : pointer to data structure, length of that data
 *@retval : None 
 *@note :  This function is called to notify client with updated regular report data
*/
void hids_kb_notify_input(const void* data, uint8_t dataLen)
{
    __ASSERT_NO_MSG(input_rep_notif_enabled);  //check if notify enabled

    int err;
    struct bt_gatt_notify_params params = {0};

    memcpy(input_report, data, dataLen);

    //params update
    params.uuid = NRF52_CHAR_HIDREPORT_UUID;
    params.data = data;
    params.len = dataLen;
    params.func = NULL;

    err = bt_gatt_notify_cb(my_connection, &params);
}

/*
 *@brief : function to notify boot report data
 *@param : pointer to data structure, length of that data
 *@retval : None 
 *@note :  This function is called to notify client with updated boot report data
*/
void hids_kb_notify_input_boot(const void* data, uint8_t dataLen){

    __ASSERT_NO_MSG(boot_input_rep_notif_enabled); //check if notify enabled

    int err;
    struct bt_gatt_notify_params params = {0};

    memcpy(boot_input_report, data, dataLen);

    //params update
    params.uuid = NRF52_CHAR_HIDBOOTREPORT_UUID;        
    params.data = data;
    params.len = dataLen;
    params.func = NULL;

    err = bt_gatt_notify_cb(my_connection, &params);
}
```

## src/hid.h
```c
#ifndef _HID_H_
#define _HID_H_

//for bluetooth
#include <zephyr/bluetooth/bluetooth.h>
#include <zephyr/bluetooth/conn.h>
#include <zephyr/bluetooth/gatt.h>
#include <zephyr/bluetooth/hci.h>
#include <zephyr/bluetooth/uuid.h>

//service and characteristics 
#define NRF52_SVC_HID_UUID         BT_UUID_HIDS_VAL                      //HID Service
#define NRF52_SVC_BAT_UUID         BT_UUID_BAS_VAL                       //Battery Status Service
#define NRF52_SVC_DEV_UUID         BT_UUID_DIS_VAL                       //Device Information Service

#define NRF52_CHAR_HIDINFO_UUID        BT_UUID_HIDS_INFO                //HID Information
#define NRF52_CHAR_HIDMAP_UUID         BT_UUID_HIDS_REPORT_MAP          //HID Report Map
#define NRF52_CHAR_HIDCTRL_UUID        BT_UUID_HIDS_CTRL_POINT          //HID Control Point
#define NRF52_CHAR_HIDREPORT_UUID      BT_UUID_HIDS_REPORT              //HID Input Report
#define NRF52_CHAR_HIDPROT_UUID        BT_UUID_HIDS_PROTOCOL_MODE       //HID Protocol Mode
#define NRF52_CHAR_HIDBOOTREPORT_UUID  BT_UUID_HIDS_BOOT_KB_IN_REPORT   //HID Boot KeyBoard Input Report

/* 
 * HID Input Report Structure (for Both Boot & Regular Report)
 *  8 bits - Modifiers
 *  8 bits - Reserved
 *  8 bits * 6 - Standard Key Presses
 * NOTE: pack your structures to avoid byte padding and save power and 
 * transmission time over BLE
 */
typedef struct
{
    uint8_t modifiers;
    uint8_t reserved;
    uint8_t key_pressed[6];
} __attribute__((__packed__)) hids_report_kb_t;

/*
 * ble function declaration
*/
void input_rep_changed(const struct bt_gatt_attr *attr, uint16_t value);
void boot_input_rep_changed(const struct bt_gatt_attr *attr, uint16_t value);

ssize_t readinfo_cb(struct bt_conn *conn,const struct bt_gatt_attr *attr,void *buf, uint16_t len,uint16_t offset);
ssize_t readreportmap_cb(struct bt_conn *conn,const struct bt_gatt_attr *attr,void *buf, uint16_t len,uint16_t offset);
ssize_t readreport_cb(struct bt_conn *conn,const struct bt_gatt_attr *attr,void *buf, uint16_t len,uint16_t offset);
ssize_t read_reportdesc_cb(struct bt_conn *conn,const struct bt_gatt_attr *attr,void *buf, uint16_t len,uint16_t offset);
ssize_t readprot_cb(struct bt_conn *conn,const struct bt_gatt_attr *attr,void *buf, uint16_t len,uint16_t offset);
ssize_t readreport_cb(struct bt_conn *conn,const struct bt_gatt_attr *attr,void *buf, uint16_t len,uint16_t offset);

ssize_t writectrl_cb(struct bt_conn *conn,const struct bt_gatt_attr *attr,const void *buf, uint16_t len,uint16_t offset, uint8_t flags);
ssize_t writeprot_cb(struct bt_conn *conn,const struct bt_gatt_attr *attr,const void *buf, uint16_t len,uint16_t offset, uint8_t flags);

void hids_connected(struct bt_conn *conn);
void hids_disconnected(void);

uint8_t hids_prot_mode(void);
bool hids_report_writable(void);

void hids_kb_notify_input(const void* data, uint8_t dataLen);
void hids_kb_notify_input_boot(const void* data, uint8_t dataLen);

void nrf52_uart_tx(uint8_t *tx_buff);

#endif
```
